## prj.conf
```kconfig
# C++ application (C++17). Exceptions/RTTI stay off (Zephyr defaults) and the
# minimal C++ runtime is kept — see notes/language-cpp.md.
CONFIG_CPP=y
CONFIG_STD_CPP17=y

# Sensor subsystem + I2C bus (SCD-40 on I2C1). CONFIG_SCD4X is default-y once the
# devicetree node exists, so it needs no explicit enable here.
CONFIG_SENSOR=y
CONFIG_I2C=y

# Read the sensor on demand from the shell (`sensor get scd40@62`) instead of
# polling in main(). Note this selects SENSOR_ASYNC_API, so the shell reads via
# the RTIO path; scd4x implements only the classic sample_fetch/channel_get, so
# it falls back to __sensor_default_decoder (drivers/sensor/default_rtio_sensor.c),
# which calls those same driver ops underneath.
CONFIG_SENSOR_SHELL=y

# printf() to the ST-LINK VCP console. CBPRINTF_FP_SUPPORT gives %f, which the
# sensor shell also needs to print sensor_value as decimals (it selects it too).
CONFIG_STDOUT_CONSOLE=y
CONFIG_CBPRINTF_FP_SUPPORT=y

# --- Networking -------------------------------------------------------------
# The MAC + LAN8742 PHY are already wired in the board devicetree (&mac status
# = "okay" + an eth_phy node), so ETH_STM32_HAL enables itself (default y on
# DT_HAS_ST_STM32_ETHERNET_ENABLED) and pulls in NOCACHE_MEMORY for the H7's DMA
# descriptors. The hardware side needs nothing here.
CONFIG_NETWORKING=y
CONFIG_NET_L2_ETHERNET=y
CONFIG_NET_IPV4=y
CONFIG_NET_IPV6=n

# net_config applies the static address at boot (NET_CONFIG_AUTO_INIT is default
# y), so no app code is needed to bring the interface up. Direct cable to the Pi
# at 192.168.10.1 on the same /24 => every peer is on-link => NO gateway.
CONFIG_NET_CONFIG_SETTINGS=y
CONFIG_NET_CONFIG_NEED_IPV4=y
CONFIG_NET_CONFIG_MY_IPV4_ADDR="192.168.10.2"
CONFIG_NET_CONFIG_MY_IPV4_NETMASK="255.255.255.0"
# The broker (Mosquitto on the Pi). Kept here so every address lives in one file.
CONFIG_NET_CONFIG_PEER_IPV4_ADDR="192.168.10.1"

# --- MQTT client ------------------------------------------------------------
# MQTT 3.1.1 over TCP. Sockets + TCP are what mqtt_lib builds on; see
# docs/mqtt-design.md for the topic/QoS decisions this implements.
CONFIG_NET_SOCKETS=y
CONFIG_NET_TCP=y
CONFIG_MQTT_LIB=y

# --- CAN --------------------------------------------------------------------
# The link to the F072RB peer node. Kconfig only: the board's own devicetree
# already enables fdcan1 on PD0/PD1 and points `chosen { zephyr,canbus }` at it,
# so unlike the SCD-40 there is no node for us to add -- only a bitrate, which
# the board dts does NOT set. See docs/can-bringup.md.
CONFIG_CAN=y
# `can` shell commands: mode, start, bitrate, send, dump, add (rx filter). This
# is what makes the link verifiable with no application code at all -- both in
# internal loopback before a transceiver exists, and against the real bus after.
#
# Note the interaction src/relay.cpp creates: the relay installs its heartbeat
# filter at boot and therefore owns filter slot 0, and M_CAN stops at the first
# match -- so `can dump` will now show NOTHING while heartbeats arrive perfectly.
# Use `can filter add <dev> 0x702`. Full mechanism in docs/can-bringup.md.
CONFIG_CAN_SHELL=y

# ISO-TP (ISO 15765-2), the segmentation layer src/relay.cpp moves protobuf over.
# A Telemetry is up to 43 bytes with its type prefix and a frame carries 8, so
# there is no way around this. notes/can-guide.md §8.
CONFIG_ISOTP=y

# The relay's two threads both drive segmented transfers through k_work_submit(),
# which is the *shared* system workqueue -- so the frame-by-frame half of every
# ISO-TP transfer runs on this stack rather than on the caller's. 1024 is the
# default and is the first number to raise if the link ever misbehaves in ways
# that look like memory corruption.
CONFIG_SYSTEM_WORKQUEUE_STACK_SIZE=2048

# --- Protobuf ---------------------------------------------------------------
# nanopb encodes/decodes the messages in proto/node.proto. The generated structs
# are fixed-size (every variable-length field is bounded in node.options), so no
# allocator is pulled in.
CONFIG_NANOPB=y

# --- zbus (internal thread-to-thread bus) -----------------------------------
# Decouples the sensor thread from the MQTT thread; see shared/app_channels.h.
# The relay's own four channels are declared in src/relay.h.
CONFIG_ZBUS=y
# Names cost a few bytes of ROM each and make zbus's own log lines readable.
CONFIG_ZBUS_CHANNEL_NAME=y
CONFIG_ZBUS_OBSERVER_NAME=y

# Message subscribers get a *copy* of every message in order, which is what the
# command channel needs (a dropped command has no next one coming). Telemetry
# uses a plain listener instead.
CONFIG_ZBUS_MSG_SUBSCRIBER=y
# Fixed-size pool rather than the system heap: same no-allocator policy as
# nanopb above.
CONFIG_ZBUS_PREFER_DYNAMIC_ALLOCATION=n
# Sized by the largest message on ANY channel -- struct relay_up, 164 B.
#
# "Any channel", not "any message-subscriber channel": with
# CONFIG_ZBUS_MSG_SUBSCRIBER=y, EVERY zbus_chan_pub() allocates a buffer from
# this pool and copies the whole message into it, whether or not the channel has
# a single message subscriber. The allocate-and-copy in _zbus_vded_exec()
# (subsys/zbus/zbus.c:244-256) is guarded by the Kconfig symbol alone, not by the
# channel's observer kinds. A listener channel does not opt out of the pool; it
# merely does not read from the buffer.
#
# Undersize it and net_buf_add_mem() runs off the end of a fixed slot in a
# contiguous uint8_t[count][size] array, silently, because the __ASSERT that
# would catch it (zbus.c:46) needs CONFIG_ASSERT=y. Message sizes, read off the
# ELF: relay_up 164, sensor_reading 44, relay_down 32, sensor_cmd 8,
# relay_status 2. static_asserts in src/relay.h and shared/app_channels.h pin
# the invariant so a new channel cannot break it unnoticed.
CONFIG_ZBUS_MSG_SUBSCRIBER_NET_BUF_STATIC_DATA_SIZE=164
CONFIG_ZBUS_MSG_SUBSCRIBER_NET_BUF_POOL_SIZE=4

# eventfd: a file descriptor the sensor side can signal and zsock_poll() can
# wait on, so the MQTT loop blocks on the socket and the bus in one call
# instead of waking on a timer to check the bus.
CONFIG_ZVFS=y
CONFIG_ZVFS_EVENTFD=y
# Four: our own telemetry, plus the relay's telemetry, ack and status. A hard
# count -- the fourth zvfs_eventfd() simply fails without this.
CONFIG_ZVFS_EVENTFD_MAX=4
# The serve loop polls six descriptors: two MQTT sockets (one per node identity)
# plus four eventfds. This sizes a struct k_poll_event array on the stack of
# EVERY zsock_poll() caller, not just ours, so it is set to exactly what is
# needed rather than rounded up.
CONFIG_ZVFS_POLL_MAX=6

# Shell + net shell: `net iface` shows link state/IP/MAC and `net ping` sends
# ICMP from the board — that is how we prove the Nucleo -> Pi direction.
CONFIG_SHELL=y
CONFIG_NET_SHELL=y

# Log the driver's link up/down and the MAC it derives from the STM32 unique ID.
CONFIG_LOG=y
CONFIG_NET_LOG=y

# A 164-byte struct relay_up and the five-slot poll array both land on main's
# stack now.
CONFIG_MAIN_STACK_SIZE=3072
```

## src/relay.cpp
```c
/* The CAN half of the gateway. See relay.h for what a relay is and why the
 * channels are shaped the way they are; docs/can-bringup.md for the link's
 * configuration and the alternatives rejected in arriving at this shape.
 *
 * This file is the mirror of peer-node/src/main.cpp seen from the other end of
 * the wire: what that file sends, this one receives.
 *
 * Two threads, split by what they block on — RX only ever reads the link, TX
 * only ever writes it. The single-writer rule is a correctness property, not
 * tidiness: two isotp_send() calls on one address from different contexts
 * interleave their frames and corrupt both transfers, and confining every write
 * to one thread enforces it without a mutex.
 */
#include "relay.h"

#include <zephyr/kernel.h>
#include <zephyr/canbus/isotp.h>
#include <zephyr/device.h>
#include <zephyr/drivers/can.h>
#include <zephyr/logging/log.h>
#include <zephyr/zbus/zbus.h>

#include <errno.h>
#include <string.h>

#include "can_link.h"
#include "protocol.h"

LOG_MODULE_REGISTER(relay, LOG_LEVEL_INF);

/* The one place the relay's byte budget meets the schema. relay.h keeps
 * kRelayUpMax as a plain number so tests and channels can size themselves
 * without the generated header; this is the check that the number is still big
 * enough. A schema change that outgrows it becomes a compile error here rather
 * than a truncated Ack on the wire. */
static_assert(node_Ack_size <= kRelayUpMax, "Ack no longer fits a relay_up");
static_assert(node_Telemetry_size <= kRelayUpMax, "Telemetry no longer fits a relay_up");
static_assert(node_Command_size <= sizeof(((struct relay_down *)nullptr)->bytes),
	      "Command no longer fits a relay_down");

/* Defined at the bottom, beside the channels; declared here so the TX thread
 * can wait on it. */
ZBUS_OBS_DECLARE(relay_cmd_sub);

namespace {

/* Which peer this gateway talks to. One today; the address helpers in
 * can_link.h all take a node id, so a second is a matter of another pair of
 * contexts rather than another protocol. */
constexpr uint8_t kPeerNodeId = kFirstPeerNodeId; /* 2 */

/* Above the sensor thread (7) because this one has a deadline the sensor does
 * not: a heartbeat that arrives while we are not listening is indistinguishable
 * from one that never came. Below main, which owns the keepalive. */
constexpr int kRxPriority = 6;
constexpr int kTxPriority = 7;
constexpr size_t kRxStackSize = 1536;
constexpr size_t kTxStackSize = 1024;

/* How long the RX thread blocks in isotp_recv() before looking at the clock.
 * It bounds how late an offline decision can be, so it wants to be well under
 * the 3.5 s timeout; it also bounds how often this thread wakes for nothing. */
constexpr int kRecvPollMs = 250;

/* How long the TX thread waits for the peer's Ack before answering on its
 * behalf. Generous against a peer that samples every 5 s and answers commands
 * from the same single thread. */
constexpr int kAckWaitMs = 2000;

const struct device *const can_dev = DEVICE_DT_GET(DT_CHOSEN(zephyr_canbus));

/* Mirror of the peer's four: what it calls "to gateway" is what we receive.
 *
 * Data and flow control are on separate identifiers so our bind and our sender
 * never install two acceptance filters for the same id — one of them would be
 * starved with no diagnostic. can_link.h names the map; docs/can-bringup.md
 * *Flow control needs its own identifiers* has the mechanism. */
const struct isotp_msg_id rx_addr = {
	.std_id = isotp_id_to_gateway(kPeerNodeId), /* 0x7E8: telemetry and acks, peer -> us */
};
const struct isotp_msg_id rx_fc_addr = {
	.std_id = isotp_fc_id_to_gateway(kPeerNodeId), /* 0x7E4: FC for our sends, peer -> us */
};
const struct isotp_msg_id tx_addr = {
	.std_id = isotp_id_to_peer(kPeerNodeId), /* 0x7E0: commands, us -> peer */
};
const struct isotp_msg_id tx_fc_addr = {
	.std_id = isotp_fc_id_to_peer(kPeerNodeId), /* 0x7EC: FC for our bind, us -> peer */
};

/* Flow control we advertise to the peer: take the whole transfer, no gaps. The
 * gateway is the fast end of this link and has no reason to throttle a node
 * sending it 25 bytes. */
const struct isotp_fc_opts fc_opts = {
	.bs = 0,
	.stmin = 0,
};

struct isotp_recv_ctx recv_ctx;
struct isotp_send_ctx send_ctx;

/* Heartbeats arrive as raw frames, so they bypass ISO-TP entirely and land in a
 * message queue filled from the driver's RX callback. A queue rather than a
 * callback that publishes directly, because can_add_rx_filter()'s callback runs
 * in ISR context and zbus_chan_pub() takes a mutex. Depth 4 covers three missed
 * wakeups at 1 Hz, which is already past the point where the peer is declared
 * offline. */
K_MSGQ_DEFINE(heartbeat_q, sizeof(struct can_frame), 4, 4);

/* The rendezvous between the two threads: RX gives it after publishing an Ack
 * upward, TX waits on it after sending a command. One semaphore is the whole
 * mechanism — no mutex, no shared mutable state — and it is what makes "at most
 * one ack outstanding" true by construction rather than by hope. */
K_SEM_DEFINE(ack_received, 0, 1);

/* ---- publishing upward ---------------------------------------------------- */

/* Copy a relayed payload onto a channel. The bytes are moved, never inspected:
 * this function does not know or care what protobuf message it is carrying. */
void publish_up(const struct zbus_channel *chan, const uint8_t *bytes, size_t len)
{
	if (len > kRelayUpMax) {
		/* Refused rather than truncated. Half a protobuf message decodes
		 * into something plausible, which is worse than nothing arriving
		 * — the same argument decode_command() makes about oversized
		 * MQTT payloads. */
		LOG_ERR("relayed payload %zu B exceeds %zu B — dropped", len, kRelayUpMax);
		return;
	}

	struct relay_up up = {};

	up.node_id = kPeerNodeId;
	up.len = static_cast<uint16_t>(len);
	memcpy(up.bytes, bytes, len);

	int rc = zbus_chan_pub(chan, &up, K_MSEC(50));

	if (rc != 0) {
		LOG_WRN("relay publish failed: %d", rc);
	}
}

void publish_status(bool online)
{
	struct relay_status st = {};

	st.node_id = kPeerNodeId;
	st.online = online;

	int rc = zbus_chan_pub(&chan_relay_status, &st, K_MSEC(50));

	if (rc != 0) {
		LOG_WRN("relay status publish failed: %d", rc);
	}
	LOG_INF("peer node %u is %s", kPeerNodeId, online ? "online" : "offline");
}

/* ---- receiving ------------------------------------------------------------ */

/* An ISO-TP payload has arrived from the peer. Read byte 0, route on it, and
 * forward the remainder untouched.
 *
 * Reading that byte is not decoding: it is the topic, moved inside the payload
 * because ISO-TP has none of its own (can_link.h). The gateway learns nothing
 * else about the message from it. */
void handle_relayed(const uint8_t *buf, size_t len)
{
	if (len < 1) {
		LOG_WRN("empty ISO-TP payload from peer");
		return;
	}

	switch (buf[0]) {
	case RELAY_MSG_TELEMETRY:
		publish_up(&chan_relay_telemetry, &buf[1], len - 1);
		break;

	case RELAY_MSG_ACK:
		publish_up(&chan_relay_ack, &buf[1], len - 1);
		/* Only after the ack is on its way upward, so the TX thread
		 * cannot be released before the thing it was waiting for
		 * exists. */
		k_sem_give(&ack_received);
		break;

	default:
		/* RELAY_MSG_COMMAND travelling upward would mean the peer is
		 * confused about which end it is; anything else is a newer peer
		 * speaking a protocol this gateway does not have. Either way
		 * there is no topic to put it on. */
		LOG_WRN("unroutable message type %u from peer %u", buf[0], kPeerNodeId);
		break;
	}
}

/* Drain the heartbeat queue. Returns true if at least one valid beat was seen,
 * which is all the liveness machine needs to know. */
bool drain_heartbeats(void)
{
	struct can_frame frame;
	bool seen = false;

	while (k_msgq_get(&heartbeat_q, &frame, K_NO_WAIT) == 0) {
		struct heartbeat hb;

		if (!heartbeat_unpack(frame.data, can_dlc_to_bytes(frame.dlc), &hb)) {
			/* A frame at the right id that we cannot parse means a
			 * peer running a layout this gateway does not know. NOT
			 * counted as liveness: pretending to understand it would
			 * report a peer as healthy while relaying nothing. */
			LOG_WRN("undecodable heartbeat from id 0x%03x", frame.id);
			continue;
		}
		seen = true;
		LOG_DBG("heartbeat: state %u, up %us, seq %u", hb.state, hb.uptime_s,
			hb.sequence_low);
	}
	return seen;
}

/* Runs in ISR context, so it does exactly one thing that is safe there. */
void heartbeat_isr(const struct device *dev, struct can_frame *frame, void *user_data)
{
	ARG_UNUSED(dev);
	ARG_UNUSED(user_data);

	/* Dropped rather than blocked if the queue is full: the RX thread is
	 * evidently not keeping up, and the newest beat is not more informative
	 * than the three already waiting. */
	k_msgq_put(&heartbeat_q, frame, K_NO_WAIT);
}

void rx_thread(void *, void *, void *)
{
	if (!device_is_ready(can_dev)) {
		LOG_ERR("CAN device not ready — relay disabled");
		return;
	}

	int rc = can_start(can_dev);

	if (rc != 0 && rc != -EALREADY) {
		LOG_ERR("can_start failed: %d — relay disabled", rc);
		return;
	}

	/* Installed before the ISO-TP bind so it takes the lower filter slot. One
	 * visible consequence: matching stops at the first match, so once this
	 * filter exists `can dump` shows nothing while heartbeats arrive perfectly.
	 * Use `can filter add <dev> 0x702` instead — docs/can-bringup.md. */
	const struct can_filter hb_filter = {
		.id = heartbeat_id(kPeerNodeId),
		.mask = CAN_STD_ID_MASK,
	};

	rc = can_add_rx_filter(can_dev, heartbeat_isr, nullptr, &hb_filter);
	if (rc < 0) {
		LOG_ERR("heartbeat filter: %d — relay disabled", rc);
		return;
	}

	rc = isotp_bind(&recv_ctx, can_dev, &rx_addr, &tx_fc_addr, &fc_opts, K_MSEC(200));
	if (rc != ISOTP_N_OK) {
		LOG_ERR("isotp_bind failed: %d — relay disabled", rc);
		return;
	}

	/* The peer logs the same four with in and out swapped. Reading the two
	 * consoles side by side is how you confirm both ends agree on the map. */
	LOG_INF("relay up: peer %u, heartbeat 0x%03x, isotp in 0x%03x (fc out 0x%03x), "
		"out 0x%03x (fc in 0x%03x)",
		kPeerNodeId, heartbeat_id(kPeerNodeId), rx_addr.std_id, tx_fc_addr.std_id,
		tx_addr.std_id, rx_fc_addr.std_id);

	/* Starts UNKNOWN, with the clock running from now. Nothing is published
	 * until either a beat arrives or the timeout elapses, so a gateway
	 * restart never briefly claims a healthy peer is dead. */
	struct liveness peer = {PEER_UNKNOWN, k_uptime_get()};

	while (true) {
		uint8_t buf[1 + kRelayUpMax];
		int len = isotp_recv(&recv_ctx, buf, sizeof(buf), K_MSEC(kRecvPollMs));

		if (len > 0) {
			handle_relayed(buf, static_cast<size_t>(len));
		} else if (len != ISOTP_RECV_TIMEOUT) {
			LOG_WRN("isotp_recv: %d", len);
		}

		/* Both the heartbeat and the clock feed the same step, so a
		 * timeout is not a special case — it is simply a step in which
		 * no frame was seen. */
		if (liveness_step(&peer, drain_heartbeats(), k_uptime_get(), kHeartbeatTimeoutMs)) {
			publish_status(peer.state == PEER_ONLINE);
		}
	}
}

/* ---- sending -------------------------------------------------------------- */

/* Answer a command the peer did not. The gateway is allowed to *author* an Ack;
 * it still never decodes the peer's.
 *
 * The one place its opacity is compromised, minimally and by name: correlating
 * this Ack needs the command's sequence, which main.cpp read out of the Command
 * envelope. Synthesizing nothing would leave the host unable to distinguish "the
 * peer is gone" from "the gateway dropped it". Recorded in docs/mqtt-design.md. */
void send_synthetic_ack(uint32_t sequence, const char *detail)
{
	uint8_t buf[node_Ack_size];
	size_t len = encode_ack(sequence, node_AckStatus_ACK_STATUS_FAILED, detail, nullptr, buf,
				sizeof(buf));

	if (len > 0) {
		publish_up(&chan_relay_ack, buf, len);
	}
}

void tx_thread(void *, void *, void *)
{
	while (true) {
		const struct zbus_channel *chan;
		struct relay_down cmd;

		if (zbus_sub_wait_msg(&relay_cmd_sub, &chan, &cmd, K_FOREVER) != 0) {
			continue;
		}
		if (chan != &chan_relay_command) {
			continue;
		}

		/* +1 for the type byte, prepended into one buffer rather than
		 * sent as a separate frame: ISO-TP delivers a payload whole or
		 * not at all, and splitting the two would reintroduce exactly
		 * the reassembly problem it exists to solve. */
		uint8_t frame[1 + sizeof(cmd.bytes)];

		frame[0] = RELAY_MSG_COMMAND;
		memcpy(&frame[1], cmd.bytes, cmd.len);

		/* Any stale give from a previous round trip is cleared here
		 * rather than after the wait, so a late ack cannot satisfy the
		 * *next* command's wait. */
		k_sem_reset(&ack_received);

		/* Blocks until the whole segmented transfer completes. That is
		 * what serialises command round trips structurally, which is the
		 * premise chan_relay_ack's latest-wins observer depends on — see
		 * relay.h. */
		int rc = isotp_send(&send_ctx, can_dev, frame, cmd.len + 1, &tx_addr, &rx_fc_addr,
				    nullptr, nullptr);

		if (rc != ISOTP_N_OK) {
			LOG_WRN("command to peer %u failed to send: %d", cmd.node_id, rc);
			send_synthetic_ack(cmd.sequence, "no route to node over CAN");
			continue;
		}

		if (k_sem_take(&ack_received, K_MSEC(kAckWaitMs)) != 0) {
			LOG_WRN("peer %u did not answer command seq=%u", cmd.node_id,
				cmd.sequence);
			send_synthetic_ack(cmd.sequence, "no response over CAN");
		}
		/* On success the RX thread has already published the peer's own
		 * Ack; there is nothing left for this thread to do. */
	}
}

}  // namespace

/* Definitions at global scope: ZBUS_CHAN_DECLARE in relay.h declares these same
 * symbols, and an anonymous namespace would give them a different linkage than
 * the declaration. notes/language-cpp.md §6. */

ZBUS_MSG_SUBSCRIBER_DEFINE(relay_cmd_sub);

/* The three upward channels. No validator on any of them: the gateway is not in
 * a position to judge a payload it does not decode, and inventing a rule here
 * would be the opposite of the whole design. The observers are defined in
 * main.cpp — the network side owns what feeds the network. */
ZBUS_CHAN_DEFINE(chan_relay_telemetry, struct relay_up,
		 nullptr, nullptr,
		 ZBUS_OBSERVERS(relay_telemetry_listener),
		 ZBUS_MSG_INIT(0));

ZBUS_CHAN_DEFINE(chan_relay_ack, struct relay_up,
		 nullptr, nullptr,
		 ZBUS_OBSERVERS(relay_ack_listener),
		 ZBUS_MSG_INIT(0));

ZBUS_CHAN_DEFINE(chan_relay_status, struct relay_status,
		 nullptr, nullptr,
		 ZBUS_OBSERVERS(relay_status_listener),
		 ZBUS_MSG_INIT(0));

/* The one downward channel, and the only relay message a message subscriber
 * actually receives — though every channel's message still has to fit the pool.
 * See the static_asserts in relay.h. */
ZBUS_CHAN_DEFINE(chan_relay_command, struct relay_down,
		 nullptr, nullptr,
		 ZBUS_OBSERVERS(relay_cmd_sub),
		 ZBUS_MSG_INIT(0));

K_THREAD_DEFINE(relay_rx_tid, kRxStackSize, rx_thread, NULL, NULL, NULL, kRxPriority, 0, 0);
K_THREAD_DEFINE(relay_tx_tid, kTxStackSize, tx_thread, NULL, NULL, NULL, kTxPriority, 0, 0);
```

## src/relay.h
```c
/* The relay: the gateway's CAN side, and the channels that join it to the MQTT
 * side.
 *
 * Deliberately NOT in app_channels.h, whose stated contract is that nothing in
 * it touches a transport; these channels exist precisely to carry one. What both
 * boards must agree on is in can_link.h. This file is the gateway's half alone,
 * and the peer node includes none of it.
 *
 * The gateway is a **transport hop**, not an aggregator. A peer node encodes its
 * own Telemetry and its own Acks, and the gateway moves those bytes between CAN
 * and MQTT without decoding them. It reads exactly one byte -- can_link.h's
 * message type, which says which topic the payload belongs on -- and strips it.
 *
 * That opacity is why the message types below are byte arrays rather than
 * node_Telemetry: a generated protobuf type in this header would make a schema
 * change on the *peer* rebuild the gateway, which is exactly the coupling the
 * design claims not to have. Compare app_channels.h, which avoids protobuf types
 * for the opposite reason -- there a schema change must stop at protocol.cpp.
 * Same goal from either end: a schema change that does not ripple.
 *
 * This header is the decisions half of notes/zbus-guide.md for the relay's four
 * channels, as app_channels.h is for the sensor's two.
 */
#ifndef RELAY_H_
#define RELAY_H_

#include <zephyr/zbus/zbus.h>

#include <stdint.h>

/* The largest relayed payload, and therefore the size of every upward message.
 *
 * Bounded by node_Ack_size (140 today), which relay.cpp pins with a
 * static_assert — it is the one translation unit allowed to include node.pb.h,
 * so the check lives there and drift becomes a compile error rather than a
 * truncated Ack on the wire. Kept here as a plain number so tests/ and the
 * channels can size themselves without pulling in the generated header. */
constexpr size_t kRelayUpMax = 160;

/* Peer node -> gateway -> broker. Telemetry and Acks both use this shape; which
 * topic it lands on is decided by which channel it arrived on, not by anything
 * inside `bytes`. */
struct relay_up {
	/* Which peer. Today always node 2, but carried explicitly so that adding
	 * a third node is a channel-observer question rather than a rewrite. */
	uint8_t node_id;
	uint16_t len;
	uint8_t bytes[kRelayUpMax];
};

/* Broker -> gateway -> peer node. Bounded by node_Command_size (20). */
struct relay_down {
	uint8_t node_id;
	uint8_t len;
	/* The one field the gateway reads out of a message it forwards. It needs
	 * the sequence so that a command the peer never answers can still be
	 * acknowledged — see the synthesized-Ack note in relay.cpp. Filled in by
	 * main.cpp, which decodes the Command *envelope* and nothing else. */
	uint32_t sequence;
	uint8_t bytes[24];
};

/* Liveness, which on CAN has to be built rather than subscribed to. */
struct relay_status {
	uint8_t node_id;
	bool online;
};

/* relay_up is the largest message on any channel in this application, and so it
 * is what CONFIG_ZBUS_MSG_SUBSCRIBER_NET_BUF_STATIC_DATA_SIZE must be sized to
 * -- despite riding listener channels, because every publish copies its whole
 * message into a pool buffer before any observer is consulted. Getting it wrong
 * is a silent overrun of a fixed-size slot, so it is checked rather than
 * trusted; docs/zbus-design.md has the mechanism.
 *
 * Guarded because the test suites enable CONFIG_ZBUS without the message
 * subscriber, so the symbol does not exist there. */
#ifdef CONFIG_ZBUS_MSG_SUBSCRIBER_NET_BUF_STATIC_DATA_SIZE
static_assert(sizeof(struct relay_up) <= CONFIG_ZBUS_MSG_SUBSCRIBER_NET_BUF_STATIC_DATA_SIZE,
	      "raise CONFIG_ZBUS_MSG_SUBSCRIBER_NET_BUF_STATIC_DATA_SIZE to sizeof(struct "
	      "relay_up)");
static_assert(sizeof(struct relay_down) <= CONFIG_ZBUS_MSG_SUBSCRIBER_NET_BUF_STATIC_DATA_SIZE,
	      "raise CONFIG_ZBUS_MSG_SUBSCRIBER_NET_BUF_STATIC_DATA_SIZE to sizeof(struct "
	      "relay_down)");
static_assert(sizeof(struct relay_status) <= CONFIG_ZBUS_MSG_SUBSCRIBER_NET_BUF_STATIC_DATA_SIZE,
	      "raise CONFIG_ZBUS_MSG_SUBSCRIBER_NET_BUF_STATIC_DATA_SIZE to sizeof(struct "
	      "relay_status)");
#endif

/* ---------------------------------------------------------------------------
 * The channels
 * ---------------------------------------------------------------------------
 *
 * The observer kind follows direction, exactly as in app_channels.h and for the
 * same argument -- state latest-wins, events not collapsed:
 *
 *   chan_relay_telemetry  LISTENER.  State; a superseded reading is one the host
 *                         is better off not receiving.
 *   chan_relay_ack        LISTENER.  An ack is an event, which would normally
 *                         argue for a message subscriber -- but relay.cpp
 *                         serialises command round trips structurally, so at
 *                         most one is ever outstanding and latest-wins cannot
 *                         collapse a set of one. main.cpp's eventfd counter
 *                         checks that premise and logs a breach at ERROR.
 *   chan_relay_status     LISTENER.  Liveness is state, and latest-wins is
 *                         precisely what a retained topic means.
 *   chan_relay_command    MESSAGE SUBSCRIBER.  A command has no next one coming.
 *
 * All four are defined in relay.cpp, per the convention that the owning module
 * defines its channels. The three listeners are defined in main.cpp beside
 * telemetry_listener: the network side owns the observers that feed the network.
 */
ZBUS_CHAN_DECLARE(chan_relay_telemetry);
ZBUS_CHAN_DECLARE(chan_relay_ack);
ZBUS_CHAN_DECLARE(chan_relay_status);
ZBUS_CHAN_DECLARE(chan_relay_command);

/* ---------------------------------------------------------------------------
 * Liveness
 * ---------------------------------------------------------------------------
 *
 * MQTT hands the gateway liveness for free: the broker notices a dead client and
 * publishes its will. CAN hands it nothing -- a silent node and an absent node
 * are the same thing (notes/can-guide.md §1) -- so the gateway builds it from a
 * heartbeat and a clock.
 *
 * The state machine is a pure function so it can be tested without a bus, a
 * clock or a thread, the same move sensor_cmd_in_range() makes in
 * app_channels.h. tests/relay/ is what exercises it.
 */
enum peer_liveness {
	/* Before anything is known. Distinct from OFFLINE on purpose: a gateway
	 * that has just booted has no evidence either way, and announcing a
	 * healthy peer as dead because we were not listening yet would be a
	 * false alarm published to a retained topic. */
	PEER_UNKNOWN,
	PEER_ONLINE,
	PEER_OFFLINE,
};

struct liveness {
	enum peer_liveness state;
	int64_t last_seen_ms;
};

/* Advance the state machine, returning true only when the state *changed* —
 * which is exactly when something needs publishing. Called on every heartbeat
 * and on every receive timeout, so it is also the thing that turns "no frames
 * arrived" into a decision.
 *
 * `last_seen_ms` must be initialised to the time the gateway started listening,
 * not to zero: the timeout is measured from the last evidence, and at boot the
 * last evidence is "we began looking". */
static inline bool liveness_step(struct liveness *l, bool frame_seen, int64_t now_ms,
				 int timeout_ms)
{
	if (frame_seen) {
		l->last_seen_ms = now_ms;
		if (l->state != PEER_ONLINE) {
			l->state = PEER_ONLINE;
			return true;
		}
		return false;
	}

	if ((now_ms - l->last_seen_ms) >= timeout_ms && l->state != PEER_OFFLINE) {
		l->state = PEER_OFFLINE;
		return true;
	}
	return false;
}

#endif /* RELAY_H_ */
```

## src/sensor.cpp
```c
/* Sensor thread: reads the Adafruit SCD-40 on its own cadence and publishes each
 * reading to the chan_telemetry zbus channel.
 *
 * This file knows nothing about MQTT, protobuf or the network. Sample the sensor
 * from the same loop that serves the socket and the two clocks become one: a
 * reconnect backoff would stop sampling. Across a channel, each side has one job
 * and one clock.
 *
 * The module owns both channels (see app_channels.h) -- the readings it produces
 * and the commands that retune it -- which is what lets the period bounds be
 * enforced by a zbus validator rather than re-checked by every publisher.
 * notes/sensor-api-guide.md and docs/sensor-bringup.md cover the SCD-40 itself.
 */
#include <zephyr/kernel.h>
#include <zephyr/device.h>
#include <zephyr/drivers/sensor.h>
#include <zephyr/logging/log.h>
#include <zephyr/zbus/zbus.h>

#include "app_channels.h"

LOG_MODULE_REGISTER(node_sensor, LOG_LEVEL_INF);

/* Defined at the bottom of the file, next to the channels; declared here so the
 * thread below can wait on it. */
ZBUS_OBS_DECLARE(sensor_cmd_sub);

namespace {

constexpr size_t kSensorStackSize = 2048;
/* Lower priority (higher number) than main: the MQTT thread should win when
 * both are runnable, since it is the one with a keepalive deadline to meet. */
constexpr int kSensorPriority = 7;

const struct device *const scd40 = DEVICE_DT_GET(DT_NODELABEL(scd40));

/* How long to wait before initialising the sensor.
 *
 * The SCD-40 will not answer on I2C until up to 30 ms after its rail comes up,
 * and the driver gets exactly one attempt: a failed init latches
 * device_is_ready() false forever, with no deinit to retry through. So the
 * devicetree marks the node `zephyr,deferred-init`, the boot sweep skips it, and
 * this thread initialises it late enough for that attempt to succeed. 100 ms is
 * a wide margin and costs nothing -- the first conversion is ~5 s away anyway.
 * docs/sensor-bringup.md has the full reasoning. */
constexpr int kSensorPowerUpMs = 100;

/* Reject a command before it ever reaches the channel. zbus_chan_pub() returns
 * -ENOMSG when this returns false, and the message is not stored or delivered —
 * so the bounds cannot be bypassed, whoever publishes. */
bool sensor_cmd_valid(const void *msg, size_t msg_size)
{
	ARG_UNUSED(msg_size);

	/* The adapter; the rule itself is sensor_cmd_in_range() in
	 * app_channels.h, next to the bounds it enforces. */
	return sensor_cmd_in_range(static_cast<const struct sensor_cmd *>(msg));
}

/* Fill `out` from the sensor. A failed read is reported, not hidden: the host
 * cannot tell a broken sensor from a dead node if we simply go quiet, which is
 * why the status field exists at all. */
void read_scd40(bool device_ok, struct sensor_reading *out)
{
	if (!device_ok) {
		out->status = SENSOR_READING_ERROR;
		return;
	}

	int rc = sensor_sample_fetch(scd40);

	if (rc != 0) {
		LOG_ERR("sample_fetch failed: %d", rc);
		out->status = SENSOR_READING_ERROR;
		return;
	}

	struct sensor_value co2, temp, hum;

	sensor_channel_get(scd40, SENSOR_CHAN_CO2, &co2);
	sensor_channel_get(scd40, SENSOR_CHAN_AMBIENT_TEMP, &temp);
	sensor_channel_get(scd40, SENSOR_CHAN_HUMIDITY, &hum);

	uint32_t co2_ppm = static_cast<uint32_t>(sensor_value_to_double(&co2));

	/* The SCD-40 reports 0 ppm until its first conversion completes. */
	if (co2_ppm == 0) {
		out->status = SENSOR_READING_WARMING_UP;
		return;
	}

	/* All three come from one conversion, so they are valid together or not at
	 * all -- which is why the presence flags are set here and nowhere else. A
	 * warming-up or failed read leaves all four false, and the host sees "no
	 * measurement" rather than a confident 0 it cannot question. Note what this
	 * node never sets: has_pressure_pa. The SCD-40 has no barometer, and saying
	 * nothing is the honest report. */
	out->co2_ppm = co2_ppm;
	out->has_co2_ppm = true;
	out->temperature_c = static_cast<float>(sensor_value_to_double(&temp));
	out->has_temperature_c = true;
	out->humidity_rh = static_cast<float>(sensor_value_to_double(&hum));
	out->has_humidity_rh = true;

	out->status = SENSOR_READING_OK;
}

void sensor_thread(void *, void *, void *)
{
	/* Deferred init: the boot sweep left this device alone, so we own the one
	 * attempt. Wait out the power-up window first — see kSensorPowerUpMs. */
	k_msleep(kSensorPowerUpMs);

	int init_rc = device_init(scd40);

	if (init_rc != 0) {
		LOG_ERR("SCD-40 init failed: %d", init_rc);
	}

	/* Read once and kept const. Re-reading per cycle would look like resilience
	 * and provide none: readiness latches at the first init attempt. */
	const bool device_ok = device_is_ready(scd40);

	if (!device_ok) {
		/* Keep sampling anyway. An explicit ERROR every period says "node
		 * alive, sensor dead"; silence would be indistinguishable from a
		 * node that fell off the network. */
		LOG_ERR("SCD-40 not ready — publishing ERROR readings");
	} else {
		LOG_INF("SCD-40 online");
	}

	uint32_t sequence = 0;
	uint32_t period_ms = SAMPLE_PERIOD_DEFAULT_MS;

	while (true) {
		struct sensor_reading reading = {};

		reading.sequence = sequence++;
		reading.uptime_ms = static_cast<uint32_t>(k_uptime_get());
		read_scd40(device_ok, &reading);

		/* Copies the reading into the channel and runs its observers.
		 * Nothing here waits for, or even knows about, a consumer: if the
		 * MQTT thread is mid-reconnect the reading is simply overwritten
		 * by the next one, and the sequence gap tells the host so. */
		int rc = zbus_chan_pub(&chan_telemetry, &reading, K_MSEC(50));

		if (rc != 0) {
			LOG_WRN("chan_telemetry publish failed: %d", rc);
		}

		/* Wait out the sample period, but wake early for a command. This one
		 * blocking call is the whole event loop: both the clock and the bus
		 * can end it. The cadence re-bases on each sample, so a trigger
		 * shifts the following samples rather than squeezing one in. */
		const int64_t last_sample = k_uptime_get();

		while (true) {
			int64_t left = (last_sample + period_ms) - k_uptime_get();

			if (left <= 0) {
				break;
			}

			const struct zbus_channel *chan;
			struct sensor_cmd cmd;

			/* A message subscriber gets its own *copy* of every
			 * message, so two commands arriving back to back are
			 * both delivered — unlike the latest-wins read the MQTT
			 * side does on chan_telemetry. */
			if (zbus_sub_wait_msg(&sensor_cmd_sub, &chan, &cmd, K_MSEC(left)) != 0) {
				break; /* timed out: the period elapsed */
			}

			/* Redundant today: sensor_cmd_sub observes one channel, so
			 * `chan` is always &chan_sensor_cmd. Kept as the shape a
			 * second observed channel would need, since all of them feed
			 * one queue and no type tag travels with the message. */
			if (chan != &chan_sensor_cmd) {
				LOG_WRN("ignoring message from %s",
					zbus_chan_name(chan));
				continue; /* re-wait on the rest of the period */
			}

			/* Exhaustive on purpose: with no `default`, a new command
			 * kind is a -Wswitch warning here rather than something
			 * that silently lands in the set-interval path. The flag
			 * is needed because a `break` inside the switch would
			 * leave the switch, not this wait loop. */
			bool sample_now = false;

			switch (cmd.kind) {
			case SENSOR_CMD_TRIGGER:
				LOG_INF("out-of-cadence measurement requested");
				sample_now = true;
				break;
			case SENSOR_CMD_SET_INTERVAL:
				/* Validated on publish, so it is in range by
				 * construction. The loop recomputes `left` from the
				 * new period, which is what makes a shortened
				 * interval take effect at once. */
				period_ms = cmd.interval_ms;
				LOG_INF("sample period set to %u ms", period_ms);
				break;
			}

			if (sample_now) {
				break;
			}
		}
	}
}

}  // namespace

/* Definitions live at global scope: ZBUS_CHAN_DECLARE in the header declares
 * these same symbols, and an anonymous namespace would give them a different
 * linkage than the declaration. notes/language-cpp.md §6.
 *
 * The macros' arguments are laid out in notes/zbus-guide.md §3. */

ZBUS_MSG_SUBSCRIBER_DEFINE(sensor_cmd_sub);

/* Sensor -> MQTT. A listener, and no validator: every reading is legal,
 * including an ERROR one -- that is a fact to report, not a value to reject. */
ZBUS_CHAN_DEFINE(chan_telemetry, struct sensor_reading,
		 nullptr,
		 nullptr,
		 ZBUS_OBSERVERS(telemetry_listener), /* defined in main.cpp */
		 ZBUS_MSG_INIT(0));

/* MQTT -> sensor. The validator is what makes the period bounds unbypassable:
 * zbus_chan_pub() returns -ENOMSG and stores nothing when it rejects, so
 * commands.cpp never re-checks them. The message subscriber is what stops two
 * commands arriving back to back from being collapsed.
 *
 * ZBUS_MSG_INIT is only ever the channel's *initial contents* -- defining a
 * channel notifies nobody, so the sensor thread never receives this. It matches
 * the period the thread starts from so neither misleads a reader of the other. */
ZBUS_CHAN_DEFINE(chan_sensor_cmd, struct sensor_cmd,
		 sensor_cmd_valid,
		 nullptr,
		 ZBUS_OBSERVERS(sensor_cmd_sub),
		 ZBUS_MSG_INIT(SENSOR_CMD_SET_INTERVAL, SAMPLE_PERIOD_DEFAULT_MS));

/* Started during kernel boot. The SCD-40's power-up wait is *inside* the thread
 * (kSensorPowerUpMs) rather than expressed as a start delay here, so it holds up
 * only this thread and not the boot sweep. */
K_THREAD_DEFINE(sensor_tid, kSensorStackSize, sensor_thread, NULL, NULL, NULL,
		kSensorPriority, 0, 0);
```
